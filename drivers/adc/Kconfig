## drivers/adc/Kconfig
```kconfig
config ADC
	bool "Enable ADC drivers using Driver Model"
	help
	  This allows drivers to be provided for ADCs to drive their features,
	  trough simple ADC uclass driver interface, with operations:
	  - device enable
	  - conversion init
	  - conversion start and return data with data mask

config ADC_EXYNOS
	bool "Enable Exynos 54xx ADC driver"
	help
	  This enables basic driver for Exynos ADC compatible with Exynos54xx.
	  It provides:
	  - 10 analog input channels
	  - 12-bit resolution
	  - 600 KSPS of sample rate
```

## drivers/power/Kconfig
```kconfig
config DM_PMIC
	bool "Enable Driver Model for PMIC drivers (UCLASS_PMIC)"
	depends on DM
	---help---
	This config enables the driver-model multi uclass PMIC support.
	Its basic uclass type is: UCLASS_PMIC, which is designed to provide
	a common I/O interface for pmic child devices of various uclass types.

	Usually PMIC IC's provides more than one functionality, which means
	that we should implement new uclass operations for each one. Usually
	PMIC's provide those various functionalities by one or more interfaces.
	And this could looks like this:

	root device
	|_ BUS 0 device (e.g. I2C0)                 - UCLASS_I2C/SPI/...
	| |_ PMIC device (READ/WRITE ops)           - UCLASS_PMIC
	|   |  (pmic sub-devices)
	|   |_ REGULATOR device (ldo/buck/... ops)  - UCLASS_REGULATOR
	|   |_ CHARGER device (charger ops)         - UCLASS_CHARGER (future)
	|   |_ MUIC device (microUSB connector ops) - UCLASS_MUIC    (future)
	|   |_ ...
	|
	|_ BUS 1 device (e.g. I2C1)                 - UCLASS_I2C/SPI/...
	   |_ PMIC device (READ/WRITE ops)          - UCLASS_PMIC
	     |  (pmic sub-devices)
	     |_ RTC device (rtc ops)                - UCLASS_MUIC (future)

	From the I/O interface point of view, there can be found two PMIC types:
	- single I/O interface - then UCLASS_PMIC device should be a parent of
	  all pmic sub-devices, where each is usually different uclass type, but
	  need to access the same interface

	- multiple I/O interfaces - for each interface the UCLASS_PMIC device
	  should be a parent of only those devices (different uclass types),
	  which needs to access the specified interface.

	For each case, binding should be done automatically. If only device tree
	nodes/subnodes are proper defined, then:
	|_ the ROOT driver will bind the device for I2C/SPI node:
	  |_ the I2C/SPI driver should bind a device for pmic node:
	    |_ the PMIC driver should bind devices for its childs:
	      |  (pmic sub-devices)
	      |_ regulator (child)
	      |_ charger   (child)
	      |_ other     (child)

	The same for other I/O bus nodes, if pmic uses more then one interface.

	Note:
	Each PMIC interface driver should use different compatible string.

	There are few basic functions in the UCLASS_PMIC driver API, declared
	in the file 'include/power/pmic.h':
	 - int pmic_get(...);
	 - int pmic_read(struct udevice *pmic, ...);
	 - int pmic_write(struct udevice *pmic, ...);
	For the simple implementation, in some cases the pmic uclass device,
	can be self-sufficient to drive the PMIC functionality. In other case,
	if each pmic sub-device(child) driver need access to the pmic specified
	registers, it need to know only the register address and then the access
	is done through the parent pmic driver. Like in the example:
	_ root driver
	|_ dev: bus I2C0                                   - UCLASS_I2C
	| |_ dev: my_pmic        (read/write)     (parent) - UCLASS_PMIC
	|   |_ dev: my_regulator (set value/etc.) (child)  - UCLASS_REGULATOR
	So the call will looks like below:
	'pmic_write(regulator->parent, addr, value, len);'

config DM_PMIC_MAX77686
	bool "Enable Driver Model for PMIC MAX77686"
	depends on DM_PMIC
	---help---
	This config enables implementation of driver-model pmic uclass features
	for PMIC MAX77686. The driver implements read/write operations/

config DM_REGULATOR
	bool "Enable Driver Model for REGULATOR drivers (UCLASS_REGULATOR)"
	depends on DM
	---help---
	This config enables the driver-model regulator uclass support, which
	provides implementation of driver model regulator uclass api.

	Regulator uclass API calls:
	To get the regulator device:
	- regulator_get()             - get the regulator device

	The regulator framework is based on a 'struct dm_regulator_ops'.
	It provides a common function calls, for it's basic features:
	- regulator_info()            - get the regulator info structure
	- regulator_mode()            - get the regulator mode info structure
	- regulator_get/set_value()   - operate on output voltage value
	- regulator_get/set_current() - operate on output current value
	- regulator_get/set_enable()  - operate on output enable state
	- regulator_get/set_mode()    - operate on output operation mode

	An optional and useful regulator framework features are two descriptors:
	- struct dm_regulator_info - describes the regulator name and output limits
	- struct dm_regulator_mode - describes the regulators operation mode

	The regulator framework features are described in file:
	- include/power/regulator.h

	Main files:
	- drivers/power/regulator-uclass.c - provides regulator common functions api
	- include/power/regulator.h - define all structures required by the regulato

	config AXP221_POWER
	boolean "axp221 / axp223 pmic support"
	depends on MACH_SUN6I || MACH_SUN8I
	default y
	---help---
	Say y here to enable support for the axp221 / axp223 pmic found on most
	sun6i (A31) / sun8i (A23) boards.

config AXP221_DCDC1_VOLT
	int "axp221 dcdc1 voltage"
	depends on AXP221_POWER
	default 3000
	---help---
	Set the voltage (mV) to program the axp221 dcdc1 at, set to 0 to
	disable dcdc1. This is typically used as generic 3.3V IO voltage for
	things like GPIO-s, sdcard interfaces, etc. On most boards this is
	undervolted to 3.0V to safe battery.

config AXP221_DLDO1_VOLT
	int "axp221 dldo1 voltage"
	depends on AXP221_POWER
	default 0
	---help---
	Set the voltage (mV) to program the axp221 dldo1 at, set to 0 to
	disable dldo1. On sun6i (A31) boards with ethernet this is often used
	to power the ethernet phy. On sun8i (A23) boards this is often used to
	power the wifi.

config AXP221_DLDO4_VOLT
	int "axp221 dldo4 voltage"
	depends on AXP221_POWER
	default 0
	---help---
	Set the voltage (mV) to program the axp221 dldo4 at, set to 0 to
	disable dldo4.

config AXP221_ALDO1_VOLT
	int "axp221 aldo1 voltage"
	depends on AXP221_POWER
	default 0
	---help---
	Set the voltage (mV) to program the axp221 aldo1 at, set to 0 to
	disable aldo1. On sun6i (A31) boards which have a wifi module this is
	often used to power the wifi module.

config AXP221_ALDO2_VOLT
	int "axp221 aldo2 voltage"
	depends on AXP221_POWER
	default 0 if MACH_SUN6I
	default 2500 if MACH_SUN8I
	---help---
	Set the voltage (mV) to program the axp221 aldo2 at, set to 0 to
	disable aldo2. On sun6i (A31) boards this is typically unused and
	should be disabled, if it is used for LPDDR2 it should be set to 1.8V.
	On sun8i (A23) this is typically connected to VDD-DLL and must be set
	to 2.5V.

config AXP221_ALDO3_VOLT
	int "axp221 aldo3 voltage"
	depends on AXP221_POWER
	default 3000
	---help---
	Set the voltage (mV) to program the axp221 aldo3 at, set to 0 to
	disable aldo3. This is typically connected to VCC-PLL and AVCC and
	must be set to 3V.

config AXP221_ELDO3_VOLT
	int "axp221 eldo3 voltage"
	depends on AXP221_POWER
	default 0
	---help---
	Set the voltage (mV) to program the axp221 eldo3 at, set to 0 to
	disable eldo3. On some A31(s) tablets it might be used to supply
	1.2V for the SSD2828 chip (converter of parallel LCD interface
	into MIPI DSI).
```
